## platform/rvcpu/Kconfig
```kconfig
# SPDX-License-Identifier: BSD-2-Clause

config PLATFORM_RVCPU
	bool
	select IPI_MSWI
	select IRQCHIP_PLIC
	select SERIAL_RVCPU
	select TIMER_MTIMER
	default y
```
